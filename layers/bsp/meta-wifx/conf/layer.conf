## layers/meta-loraserver/meta-tools/conf/layer.conf
```bitbake
# We have a conf and classes directory, add to BBPATH
BBPATH .= ":${LAYERDIR}"

# We have recipes-* directories, add to BBFILES
BBFILES += "${LAYERDIR}/recipes-*/*/*.bb \
	${LAYERDIR}/recipes-*/*/*.bbappend"

BBFILE_COLLECTIONS += "tools"
BBFILE_PATTERN_tools = "^${LAYERDIR}/"
LAYERSERIES_COMPAT_tools = "thud"
```

## layers/targets/meta-pcengines/conf/layer.conf
```bitbake
# We have a conf and classes directory, add to BBPATH
BBPATH .= ":${LAYERDIR}"

# We have recipes-* directories, add to BBFILES
BBFILES += "${LAYERDIR}/recipes-*/*/*.bb \
	${LAYERDIR}/recipes-*/*/*.bbappend"

# Remove alsa
MACHINE_FEATURES_remove = "alsa"

# Add kernel to image
IMAGE_INSTALL_append = " kernel-image"

# Configuration for the rootfs overlay.
INITRAMFS_IMAGE_NAME = "rootfs-overlay-initramfs-${MACHINE}"
INITRAMFS_TASK =  "rootfs-overlay-initramfs:do_image_complete"
```

## layers/targets/meta-pcengines/recipes-swupdate/swupdate/files/defconfig
```kconfig
#
CONFIG_CURL=y
CONFIG_CURL_SSL=y
# CONFIG_SYSTEMD is not set
CONFIG_SCRIPTS=y
CONFIG_HW_COMPATIBILITY=y
CONFIG_HW_COMPATIBILITY_FILE="/etc/hwrevision"
CONFIG_SW_VERSIONS_FILE="/etc/sw-versions"

#
# Socket Paths
#
CONFIG_SOCKET_CTRL_PATH="/tmp/sockinstctrl"
CONFIG_SOCKET_PROGRESS_PATH="/tmp/swupdateprog"
CONFIG_SOCKET_REMOTE_HANDLER_DIRECTORY="/tmp/"
# CONFIG_MTD is not set
CONFIG_LUA=y
CONFIG_LUAPKG="lua"
# CONFIG_FEATURE_SYSLOG is not set

#
# Build Options
#
CONFIG_CROSS_COMPILE=""
CONFIG_SYSROOT=""
CONFIG_EXTRA_CFLAGS=""
CONFIG_EXTRA_LDFLAGS=""
CONFIG_EXTRA_LDLIBS=""

#
# Debugging Options
#
# CONFIG_DEBUG is not set
# CONFIG_WERROR is not set
# CONFIG_NOCLEANUP is not set
# CONFIG_BOOTLOADER_EBG is not set
# CONFIG_UBOOT is not set
# CONFIG_BOOTLOADER_NONE is not set
CONFIG_BOOTLOADER_GRUB=y
CONFIG_GRUBENV_PATH="/boot/grub/grubenv"
CONFIG_DOWNLOAD=y
CONFIG_DOWNLOAD_SSL=y
CONFIG_CHANNEL_CURL=y
CONFIG_CHANNEL_CURL_SSL=y
# CONFIG_HASH_VERIFY is not set
# CONFIG_SIGNED_IMAGES is not set
# CONFIG_ENCRYPTED_IMAGES is not set
# CONFIG_SURICATTA is not set
# CONFIG_WEBSERVER is not set
# CONFIG_MONGOOSE is not set
CONFIG_GUNZIP=y
# CONFIG_ZSTD is not set

#
# Parser Features
#
CONFIG_LIBCONFIG=y
CONFIG_PARSERROOT=""
# CONFIG_JSON is not set
# CONFIG_LUAEXTERNAL is not set
# CONFIG_SETSWDESCRIPTION is not set

#
# Image Handlers
#
CONFIG_RAW=y
# CONFIG_RDIFFHANDLER is not set
CONFIG_LUASCRIPTHANDLER=y
CONFIG_SHELLSCRIPTHANDLER=y
# CONFIG_HANDLER_IN_LUA is not set
# CONFIG_ARCHIVE is not set
# CONFIG_REMOTE_HANDLER is not set
# CONFIG_SWUFORWARDER_HANDLER is not set
CONFIG_BOOTLOADERHANDLER=y
# CONFIG_UCFWHANDLER is not set
```

## layers/targets/meta-pcengines/wic/chirpstack-gateway-os.wks
```
# boot
part /boot --source bootimg-grub-legacy  --ondisk sda --label msdos    --align 1024 --fixed-size 64 --active
# rootfs a
part /     --source rootfs --fstype=ext4 --ondisk sda --label rootfs-a --align 4096 --fixed-size 512
# rootfs b
part       --source rootfs --fstype=ext4 --ondisk sda --label rootfs-b --align 4096 --fixed-size 512
# data
part /data                 --fstype=ext4 --ondisk sda --label data     --align 4096 --fixed-size 512
bootloader  --ptable msdos --timeout=5 --append="rootfstype=ext4 console=ttyS0,115200 earlyprintk=serial,ttyS0,115200"
```

## layers/targets/meta-raspberrypi/conf/layer.conf
```bitbake
# We have a conf and classes directory, add to BBPATH
BBPATH .= ":${LAYERDIR}"

# We have recipes-* directories, add to BBFILES
BBFILES += "${LAYERDIR}/recipes-*/*/*.bb \
	${LAYERDIR}/recipes-*/*/*.bbappend"

# Remove alsa
MACHINE_FEATURES_remove = "alsa"

# Boot Raspberry Pi using u-boot
RPI_USE_U_BOOT = "1"

# Add kernel to image
IMAGE_INSTALL_append = " kernel-image"

# Remove kernel from boot partition
IMAGE_BOOT_FILES_remove = "uImage"

# Configuration for the rootfs overlay.
INITRAMFS_IMAGE_NAME = "rootfs-overlay-initramfs-${MACHINE}"
INITRAMFS_TASK =  "rootfs-overlay-initramfs:do_image_complete"

# This config option is not set for the raspberrypi machine:
# https://github.com/agherzan/meta-raspberrypi/blob/329b50f252ed9abda98841266d126f77f3cc56a0/conf/machine/raspberrypi.conf
#
# Without, the following warning is raised when generating the -update images:
# do_swuimage: BitBake variable SDIMG_KERNELIMAGE not set
SDIMG_KERNELIMAGE_raspberrypi ?= "kernel.img"
```

## layers/targets/meta-raspberrypi/recipes-swupdate/swupdate/files/defconfig
```kconfig
CONFIG_HAVE_DOT_CONFIG=y
CONFIG_SCRIPTS=y
CONFIG_HW_COMPATIBILITY=y
CONFIG_HW_COMPATIBILITY_FILE="/etc/hwrevision"
CONFIG_SW_VERSIONS_FILE="/etc/sw-versions"
CONFIG_LUA=y
CONFIG_LUAPKG="lua"
CONFIG_CROSS_COMPILE=""
CONFIG_SYSROOT=""
CONFIG_EXTRA_CFLAGS=""
CONFIG_EXTRA_LDFLAGS=""
CONFIG_EXTRA_LDLIBS=""
CONFIG_UBOOT=y
CONFIG_UBOOT_NEWAPI=y
CONFIG_UBOOT_FWENV="/etc/fw_env.config"
CONFIG_SURICATTA_SERVER_NONE=y
CONFIG_WEBSERVER=y
CONFIG_MONGOOSE=y
CONFIG_MONGOOSELUA=y
CONFIG_MONGOOSEIPV6=y
CONFIG_MONGOOSESSL=y
CONFIG_GUNZIP=y
CONFIG_LIBCONFIG=y
CONFIG_PARSERROOT=""
CONFIG_CFI=y
CONFIG_RAW=y
CONFIG_LUASCRIPTHANDLER=y
CONFIG_SHELLSCRIPTHANDLER=y
CONFIG_BOOTLOADERHANDLER=y
```

## layers/targets/meta-raspberrypi/wic/chirpstack-gateway-os.wks
```
# boot
part --source bootimg-partition --ondisk mmcblk0 --fstype=vfat --label boot --active --align 4096 --size 40
# rootfs a
part --source rootfs --ondisk mmcblk0 --fstype=ext4 --label rootfs-a --align 4096 --fixed-size 512
# rootfs b
part --source rootfs --ondisk mmcblk0 --fstype=ext4 --label rootfs-b --align 4096 --fixed-size 512
# data
part --ondisk mmcblk0 --fstype=ext4 --label data --align 4096 --fixed-size 512
```

## layers/targets/meta-wifx/conf/layer.conf
```bitbake
# We have a conf and classes directory, add to BBPATH
BBPATH .= ":${LAYERDIR}"

# We have recipes-* directories, add to BBFILES
BBFILES += "${LAYERDIR}/recipes-*/*/*.bb \
	${LAYERDIR}/recipes-*/*/*.bbappend"


# Configure mender features
MENDER_FEATURES_ENABLE_append = " mender-install mender-uboot mender-image mender-image-sd"
MENDER_FEATURES_DISABLE_append = " mender-grub mender-image-uefi"

# Same as raspberrypi target
MENDER_PARTITION_ALIGNMENT = "4194304"

# Mender storage total and data-partition size.
MENDER_STORAGE_TOTAL_SIZE_MB = "2048"
MENDER_DATA_PART_SIZE_MB = "1024"

# To be able to update the Linux kernel Mender
# uses an image that resides on the root file system and below line
# ensures that they are installed to /boot
IMAGE_INSTALL_append = " kernel-image kernel-devicetree"

# Use the same type here as specified in ARTIFACTIMG_FSTYPE to avoid
# building an unneeded image file.
SDIMG_ROOTFS_TYPE = "ext4"

# Generate compressed sdimg.
IMAGE_FSTYPES += "sdimg.gz"

# Configuration for the rootfs overlay.
INITRAMFS_IMAGE_NAME = "rootfs-overlay-initramfs-${MACHINE}"
INITRAMFS_TASK =  "rootfs-overlay-initramfs:do_image_complete"
```

## meta/conf/bblayers.conf.sample
```bitbake
# POKY_BBLAYERS_CONF_VERSION is increased each time build/conf/bblayers.conf
# changes incompatibly
POKY_BBLAYERS_CONF_VERSION = "1"

BBPATH = "${TOPDIR}"
BBFILES ?= ""

BBLAYERS ?= " \
  ##OEROOT##/meta \
  ##OEROOT##/layers/meta-swupdate \
  ##OEROOT##/layers/meta-clang \
  ##OEROOT##/layers/bsp/meta-raspberrypi \
  ##OEROOT##/layers/openembedded/meta-openembedded/meta-networking \
  ##OEROOT##/layers/openembedded/meta-openembedded/meta-filesystems \
  ##OEROOT##/layers/openembedded/meta-openembedded/meta-python \
  ##OEROOT##/layers/openembedded/meta-openembedded/meta-oe \
  ##OEROOT##/layers/openembedded/openembedded-core/meta \
"
```

## meta/conf/distro/chirpstack-gateway-os.conf
```bitbake
DISTRO = "chirpstack-gateway-os"
DISTRO_NAME = "ChirpStack Gateway OS"
DISTRO_VERSION = "4.1.0"

DISTRO_FEATURES:append = " wifi"
EXTRA_IMAGE_FEATURES:append = " ssh-server-dropbear"

# Used by rpi-config bbappend.
RPI_KERNEL_DEVICETREE_OVERLAYS:append = " overlays/spi0-1cs.dtbo"

RUSTVERSION = "1.66%"
PREFERRED_VERSION_cargo = "1.66.1"
PREFERRED_VERSION_rust = "1.66.1"
```

## meta/conf/distro/lora-gateway-os.conf
```bitbake
DISTRO = "lora-gateway-os"
DISTRO_NAME = "LoRa Gateway OS"
DISTRO_VERSION = "3.0.0test3"

PACKAGE_CLASSES = "package_ipk"
IMAGE_INSTALL_append = " opkg "
EXTRA_IMAGE_FEATURES += "package-management ssh-server-dropbear"
```
