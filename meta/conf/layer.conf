## meta/conf/layer.conf
```bitbake
# We have a conf and classes directory, add to BBPATH
BBPATH .= ":${LAYERDIR}"

# We have recipes-* directories, add to BBFILES
BBFILES += "${LAYERDIR}/recipes-*/*/*.bb \
	${LAYERDIR}/recipes-*/*/*.bbappend"

BBFILE_COLLECTIONS += "chirpstack-gateway-os"

BBFILE_PATTERN_chirpstack-gateway-os = "^${LAYERDIR}/"
LAYERSERIES_COMPAT_chirpstack-gateway-os = "kirkstone"

# Remove alsa
MACHINE_FEATURES:remove = "alsa"

# Boot Raspberry Pi using u-boot
RPI_USE_U_BOOT = "1"

# Add kernel to image
IMAGE_INSTALL:append = " kernel-image"

# Remove kernel from boot partition
IMAGE_BOOT_FILES:remove = "uImage"

# Configuration for the rootfs overlay.
# This is different than the documented way of embedding an initramfs. The
# problem with the documented way is that it creates an additional kernel
# image, the one installed in the rootfs is the kernel without initramfs.
INITRAMFS_IMAGE = "rootfs-overlay-initramfs"
INITRAMFS_IMAGE_BUNDLE="1"
#INITRAMFS_IMAGE_NAME = "rootfs-overlay-initramfs-${MACHINE}"
#INITRAMFS_TASK =  "rootfs-overlay-initramfs:do_image_complete"

# This config option is not set for the raspberrypi machine:
# https://github.com/agherzan/meta-raspberrypi/blob/329b50f252ed9abda98841266d126f77f3cc56a0/conf/machine/raspberrypi.conf
#
# Without, the following warning is raised when generating the -update images:
# do_swuimage: BitBake variable SDIMG_KERNELIMAGE not set
SDIMG_KERNELIMAGE:raspberrypi ?= "kernel.img"
```

## meta/conf/local.conf.sample
```bitbake
# Leave this to 'chirpstack-gateway-os"
DISTRO = "chirpstack-gateway-os"

# Select the target machine:
#  * raspberrypi
#  * raspberrypi0-wifi
#  * raspberrypi3
#  * raspberrypi4
MACHINE = "raspberrypi3"

# Parallel executed tasks
BB_NUMBER_THREADS ?= "${@oe.utils.cpu_count()*2}"
PARALLEL_MAKE ?= "-j ${@oe.utils.cpu_count()*2}"

# Deploy dir
#
# This is the place where you will find the build artifacts.
TMPDIR = "${TOPDIR}/tmp/${MACHINE}"
DEPLOY_DIR = "${TMPDIR}/deploy/${DISTRO_VERSION}"
DEPLOY_DIR_IMAGE = "${DEPLOY_DIR}/images"
```

## meta/wic/chirpstack-gateway-os.wks
```
# boot
part --source bootimg-partition --ondisk mmcblk0 --fstype=vfat --label boot --active --align 4096 --fixed-size 40
# rootfs a
part --source rootfs --ondisk mmcblk0 --fstype=ext4 --label rootfs-a --align 4096 --fixed-size 1024
# rootfs b
part --source rootfs --ondisk mmcblk0 --fstype=ext4 --label rootfs-b --align 4096 --fixed-size 1024
# data
part --ondisk mmcblk0 --fstype=ext4 --label data --align 4096 --fixed-size 1024
```
